## conf/bblayers.conf.sample
```bitbake
# POKY_BBLAYERS_CONF_VERSION is increased each time build/conf/bblayers.conf
# changes incompatibly
POKY_BBLAYERS_CONF_VERSION = "2"

BBPATH = "${TOPDIR}"
BBFILES ?= ""

BBLAYERS ?= " \
  ../../meta \
  ../../meta-poky \
  ../../meta-yocto-bsp \
  ../../meta-openembedded/meta-oe \
  ../../meta-labview \
  "

BBLAYERS_NON_REMOVABLE ?= " \
  ../../meta \
  ../../meta-yocto-bsp \
  ../../meta-poky \
  "
```

## conf/machine/x64.conf
```bitbake
#@TYPE: Machine
#@NAME: x64

#@WEBTITLE: Generic Intel x86 64-bit machine

#@DESCRIPTION: Machine configuration for a generic x86 64-bit machine

DEFAULTTUNE ?= "core2-64"

require conf/machine/include/tune-core2.inc
require conf/machine/include/x86-base.inc

IMAGE_FSTYPES += "tar.gz ext4"
```
